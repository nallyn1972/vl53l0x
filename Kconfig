## Kconfig
```kconfig
menu "VL53L0X"

config VL53L0X_POLLING_DELAY_MS
    int "Polling delay in milliseconds"
    default 2
    range 0 20
    help
        Delay used by VL53L0X_PollingDelay during internal polling loops.

config VL53L0X_I2C_TIMEOUT_MS
    int "I2C transfer timeout in milliseconds"
    default 100
    range 10 1000
    help
        Timeout used for each I2C transmit/receive operation.

endmenu
```

## examples/esp32_test_app/main/Kconfig.projbuild
```kconfig
menu "VL53L0X Test App"

config VL53L0X_TEST_I2C_SDA
    int "I2C SDA GPIO"
    default 21

config VL53L0X_TEST_I2C_SCL
    int "I2C SCL GPIO"
    default 22

config VL53L0X_TEST_XSHUT_GPIO
    int "XSHUT GPIO (-1 to disable)"
    default -1

config VL53L0X_TEST_GPIO1_GPIO
    int "GPIO1 interrupt pin (-1 to disable)"
    default -1

config VL53L0X_TEST_PERIOD_MS
    int "Measurement period (ms)"
    default 1000
    range 50 10000

endmenu
```
